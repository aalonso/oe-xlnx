## conf/distro/alligator-uclibc.conf
```bitbake
#############################################################################
#@TYPE: Distribution
#@NAME: Alligator uclibc
#@DESCRIPTION: Alligator Micro Linux Distribution (uclibc based)
#@MAINTAINER: Adrian Alonso <aalonso00@gmail.com>
#@COMMENT: This distribution configuration defines a Micro Linux distribution
#@COMMENT: based on uclibc.
#############################################################################

#############################################################################
# DISTRO CONFIGURATION
#############################################################################

DISTRO_NAME = "alligator-uclibc"

#############################################################################
# TOOLCHAIN
#############################################################################

LIBC = "uclibc"
# Based on the Micro Linux distribution
require conf/distro/alligator.conf

# Use overrides for micro as well
OVERRIDES .= ":alligator"
```

## conf/machine/include/tune-microblaze.inc
```bitbake
TARGET_CC_ARCH = "-mcpu=microblaze"
BASE_PACKAGE_ARCH = "microblaze"
FEED_ARCH = "microblaze"
#PACKAGE_EXTRA_ARCHS += "microblaze"
```

## conf/machine/xilinx-microblaze.conf
```bitbake
# Copyright (C) 2010, Adrian Alonso <aalonso00@gmail.com>
# Released under the MIT license (see packages/COPYING)
#@TYPE: Machine
#@Name: Xilinx microblaze plaftform support
#@DESCRIPTION: Machine configuration for Xilinx microblaze generic board

TARGET_ARCH = "microblaze"
TARGET_CPU = "microblaze"
TARGET_FPU = "soft"
#tune microblaze cpu
require conf/machine/include/tune-microblaze.inc

#ASSUME_PROVIDED += "virtual/kernel"
PREFERRED_PROVIDER_virtual/kernel = "linux-xlnx-2.6.x"

MACHINE_FEATURES = "kernel26 ext2 nfs"
MACHINE_EXTRA_RECOMMENDS = "kernel-modules"

UBOOT_ARCH = "microblaze"
UBOOT_MACHINE = "microblaze_defconfig"
UBOOT_ENTRYPOINT  ?= "0x00000000"
UBOOT_LOADADDRESS ?= "0x00000000"

# Don't use tty1
USE_VT = "0"
SERIAL_CONSOLE = "9600 ttyUL0"

# Devices nodes for system ace
IMAGE_DEVICE_TABLES = "files/device_table-minimal.txt \
                       files/device_table-add-xsa.txt"
```

## conf/machine/xilinx-ml507.conf
```bitbake
# Copyright (C) 2009, Adrian Alonso <aalonso00@gmail.com>
# Released under the MIT license (see packages/COPYING)
#@TYPE: Machine
#@Name: Xilinx ML507 FPGA Development Platform
#@DESCRIPTION: Machine configuration for Xilinx ML507

TARGET_ARCH = "powerpc"
TARGET_CPU = "440"
TARGET_FPU = "soft"
#tune for the 440 cpu
require conf/machine/include/tune-ppc440.inc

#ASSUME_PROVIDED += "virtual/kernel"
PREFERRED_PROVIDER_virtual/kernel = "linux"

MACHINE_FEATURES = "kernel26 ext2"
MACHINE_EXTRA_RECOMMENDS = "kernel-modules"

UBOOT_ARCH = "powerpc"
UBOOT_MACHINE = "ppc440-generic_defconfig"

SERIAL_CONSOLE = "115200 ttyS0"
```

## conf/machine/xilinx-spartan3e.conf
```bitbake
# Copyright (C) 2009, Adrian Alonso <aalonso00@gmail.com>
# Released under the MIT license (see packages/COPYING)
#@TYPE: Machine
#@Name: Xilinx Spartan3e FPGA Development Platform
#@DESCRIPTION: Machine configuration for Xilinx Spartan3e

TARGET_ARCH = "microblaze"
TARGET_CPU = "microblaze"
TARGET_FPU = "soft"
#tune microblaze cpu
require conf/machine/include/tune-microblaze.inc

#ASSUME_PROVIDED += "virtual/kernel"
PREFERRED_PROVIDER_virtual/kernel = "linux-spartan3e-xilinx-2.6.x"

MACHINE_FEATURES = "kernel26 ext2 nfs"
#MACHINE_EXTRA_RECOMMENDS = "kernel-modules"

UBOOT_ARCH = "microblaze"
UBOOT_MACHINE = "microblaze_defconfig"

SERIAL_CONSOLE = "9600 ttyUL0"
```
